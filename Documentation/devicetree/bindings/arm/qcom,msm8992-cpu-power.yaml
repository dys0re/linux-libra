## Documentation/devicetree/bindings/arm/qcom,msm8992-cpu-power.yaml
```yaml
# SPDX-License-Identifier: (GPL-2.0-only OR BSD-2-Clause)
%YAML 1.2
---
$id: http://devicetree.org/schemas/arm/qcom,msm8992-cpu-power.yaml#
$schema: http://devicetree.org/meta-schemas/core.yaml#

title: Qualcomm MSM8992 legacy CPU power controls

maintainers:
  - Konrad Dybcio <konradybcio@kernel.org>

properties:
  compatible:
    enum:
      - qcom,msm8992-cpu-power
      - qcom,msm8992-acc
  reg:
    minItems: 2
    maxItems: 7
  reg-names:
    minItems: 2
    maxItems: 7

allOf:
  - if:
      properties:
        compatible:
          const: qcom,msm8992-cpu-power
    then:
      properties:
        reg:
          minItems: 7
        reg-names:
          items:
            - const: a53-l2
            - const: a57-l2
            - const: a53-saw
            - const: a57-saw
            - const: a53-q2s
            - const: a57-q2s
            - const: l2-kick
    else:
      properties:
        reg:
          maxItems: 2
        reg-names:
          items:
            - const: ldo
            - const: acc

required:
  - compatible
  - reg
  - reg-names

additionalProperties: false
```

## Documentation/devicetree/bindings/clock/qcom,msm8992-cpu-aux-clock.yaml
```yaml
# SPDX-License-Identifier: GPL-2.0-only OR BSD-2-Clause
%YAML 1.2
---
$id: http://devicetree.org/schemas/clock/qcom,msm8992-cpu-aux-clock.yaml#
$schema: http://devicetree.org/meta-schemas/core.yaml#

title: Qualcomm MSM8992 CPU auxiliary clock

maintainers:
  - Konrad Dybcio <konradybcio@kernel.org>

description: |
  Fixed auxiliary GPLL0 clock path used for CPU cold-boot bring-up, without
  CPU PLL scaling or regulator/CPR voltage control. The ACC boot code selects
  this path before releasing secondary CPUs.

properties:
  compatible:
    const: qcom,msm8992-cpu-aux-clock
  clocks:
    maxItems: 1
  clock-names:
    const: aux
  '#clock-cells':
    const: 0

required:
  - compatible
  - clocks
  - clock-names
  - '#clock-cells'

additionalProperties: false
```

## Documentation/devicetree/bindings/clock/qcom,msm8992-cpu-clock.yaml
```yaml
# SPDX-License-Identifier: (GPL-2.0-only OR BSD-2-Clause)
%YAML 1.2
---
$id: http://devicetree.org/schemas/clock/qcom,msm8992-cpu-clock.yaml#
$schema: http://devicetree.org/meta-schemas/core.yaml#

title: Qualcomm MSM8992 cluster clocks

maintainers:
  - Konrad Dybcio <konradybcio@kernel.org>

description: |
  Two cluster clocks for the four Cortex-A53 and two Cortex-A57 CPUs.
  Registers and PLL sequencing follow the MSM8992 factory implementation.
  Low frequency operating points use PLL0 main output or the existing
  600 MHz GPLL0 auxiliary source; high frequencies use PLL0 early output.
  The third output is the CCI clock. APC voltage coordination is handled
  by the companion MSM8992 cpufreq driver using CPR fuse calibration.

properties:
  compatible:
    const: qcom,msm8992-cpu-clock

  reg:
    items:
      - description: A53 PLLs
      - description: A57 PLLs
      - description: A53 cluster mux
      - description: A57 cluster mux
      - description: CCI PLL
      - description: CCI secure mux

  reg-names:
    items:
      - const: a53-pll
      - const: a57-pll
      - const: a53-mux
      - const: a57-mux
      - const: cci-pll
      - const: cci-mux

  clocks:
    items:
      - description: GPLL0 auxiliary clock
      - description: 19.2 MHz crystal reference

  clock-names:
    items:
      - const: aux
      - const: xo

  power-domains:
    maxItems: 1
    description: RPM VDDMX always-on domain supplying PLL digital logic

  '#clock-cells':
    const: 1
    description: 0 for A53, 1 for A57, 2 for CCI

required:
  - compatible
  - reg
  - reg-names
  - clocks
  - clock-names
  - power-domains
  - '#clock-cells'

additionalProperties: false
```

## Documentation/devicetree/bindings/cpufreq/qcom,msm8992-cpufreq.yaml
```yaml
# SPDX-License-Identifier: (GPL-2.0-only OR BSD-2-Clause)
%YAML 1.2
---
$id: http://devicetree.org/schemas/cpufreq/qcom,msm8992-cpufreq.yaml#
$schema: http://devicetree.org/meta-schemas/core.yaml#

title: Qualcomm MSM8992 CPU and shared CCI voltage/frequency coordination

maintainers:
  - Konrad Dybcio <konradybcio@kernel.org>

description: |
  Factory frequency plans and calibrated CPR open-loop voltages for the
  A53/A57 clusters. The CCI shares the A53 APC supply. Temperature sensing
  must be available before frequency scaling is enabled. Calibration data
  is read-only; this binding does not enable closed-loop CPR adaptation.

properties:
  compatible:
    const: qcom,msm8992-cpufreq

  reg:
    items:
      - description: A53 CPR control registers
      - description: A57 CPR control registers

  clocks:
    items:
      - description: A53 cluster clock
      - description: A57 cluster clock
      - description: Shared CCI clock

  clock-names:
    items:
      - const: a53
      - const: a57
      - const: cci

  apc0-supply:
    description: A53 and CCI supply

  apc1-supply:
    description: A57 supply

  qcom,saw-regs:
    description: SAW voltage-controller register banks for A53/CCI and A57
    $ref: /schemas/types.yaml#/definitions/phandle-array
    items:
      - items:
          - description: A53/CCI SAW controller
      - items:
          - description: A57 SAW controller

  power-domains:
    maxItems: 1
    description: RPM VDDMX always-on domain

  nvmem-cells:
    items:
      - description: Corrected QFPROM row 62 used by factory CPR
      - description: Corrected QFPROM row 137 used by factory CPR
      - description: Corrected QFPROM row 22 used by factory CPR
      - description: Corrected QFPROM row 138 used by factory CPR
      - description: Corrected QFPROM row 139 used by factory CPR
      - description: Corrected QFPROM row 140 used by factory CPR
      - description: Corrected QFPROM row 56 used by factory CPR
      - description: Corrected QFPROM row 57 used by factory CPR
      - description: Corrected QFPROM row 136 used by factory CPR
      - description: Raw A53 speed-bin row used by the factory clock driver

  nvmem-cell-names:
    items:
      - const: cpr-row62
      - const: cpr-row137
      - const: cpr-row22
      - const: cpr-row138
      - const: cpr-row139
      - const: cpr-row140
      - const: cpr-row56
      - const: cpr-row57
      - const: cpr-row136
      - const: speedbin

required:
  - compatible
  - reg
  - clocks
  - clock-names
  - apc0-supply
  - apc1-supply
  - power-domains
  - nvmem-cells
  - nvmem-cell-names

additionalProperties: false
```

## Documentation/devicetree/bindings/display/panel/sharp,libra-rsp61322.yaml
```yaml
# SPDX-License-Identifier: GPL-2.0-only OR BSD-2-Clause
%YAML 1.2
---
$id: http://devicetree.org/schemas/display/panel/sharp,libra-rsp61322.yaml#
$schema: http://devicetree.org/meta-schemas/core.yaml#

title: Xiaomi Mi 4C Sharp RSP61322 1080p video-mode panel

maintainers:
  - Konrad Dybcio <konradybcio@kernel.org>

allOf:
  - $ref: panel-common.yaml#

properties:
  compatible:
    const: sharp,libra-rsp61322
  reg:
    maxItems: 1
  avdd-supply:
    description: Positive 5.5 V panel bias (LAB).
  avee-supply:
    description: Negative 5.5 V panel bias (IBB).
  reset-gpios:
    maxItems: 1
    description: Active-low panel reset.
  enable-gpios:
    maxItems: 1
  backlight: true
  port: true

required:
  - compatible
  - reg
  - avdd-supply
  - avee-supply
  - reset-gpios
  - enable-gpios
  - backlight
  - port

unevaluatedProperties: false
```

## Documentation/devicetree/bindings/phy/qcom,msm8992-pcie-phy.yaml
```yaml
# SPDX-License-Identifier: (GPL-2.0-only OR BSD-2-Clause)
%YAML 1.2
---
$id: http://devicetree.org/schemas/phy/qcom,msm8992-pcie-phy.yaml#
$schema: http://devicetree.org/meta-schemas/core.yaml#

title: Qualcomm MSM8992 20nm PCIe QMP PHY

maintainers:
  - Libra maintainers <codex@openai.com>

description: |
  The 19.2 MHz PCIe PHY exports a 125 MHz PIPE clock to GCC. The GCC
  gated PIPE clock is enabled only after the factory calibration sequence.

properties:
  compatible:
    const: qcom,msm8992-pcie-phy
  reg:
    maxItems: 1
  clocks:
    maxItems: 1
  clock-names:
    const: pipe
  resets:
    maxItems: 1
  reset-names:
    const: pipe
  '#phy-cells':
    const: 0
  '#clock-cells':
    const: 0

required:
  - compatible
  - reg
  - clocks
  - clock-names
  - resets
  - reset-names
  - '#phy-cells'
  - '#clock-cells'

additionalProperties: false
...
```

## Documentation/devicetree/bindings/phy/qcom,msm8992-usb-hs-phy.yaml
```yaml
# SPDX-License-Identifier: (GPL-2.0-only OR BSD-2-Clause)
%YAML 1.2
---
$id: http://devicetree.org/schemas/phy/qcom,msm8992-usb-hs-phy.yaml#
$schema: http://devicetree.org/meta-schemas/core.yaml#

title: Qualcomm MSM8992 USB2 high-speed PHY

maintainers:
  - Konrad Dybcio <konradybcio@kernel.org>

description: |
  USB2 PHY controlled through its CSR bank and the DWC3 QSCRATCH bank.
  QSCRATCH is shared with the Qualcomm DWC3 glue controller. The CX and
  MX domains replace the downstream corner regulator supplies.

properties:
  compatible:
    const: qcom,msm8992-usb-hs-phy
  reg:
    items:
      - description: USB2 PHY CSR registers
      - description: Shared DWC3 QSCRATCH registers
  reg-names:
    items:
      - const: phy-csr
      - const: qscratch
  "#phy-cells":
    const: 0
  clocks:
    maxItems: 3
  clock-names:
    items:
      - const: ref
      - const: ahb
      - const: sleep
  resets:
    maxItems: 1
  power-domains:
    maxItems: 2
  power-domain-names:
    items:
      - const: cx
      - const: mx
  required-opps:
    maxItems: 2
  vdda1p8-supply: true
  vdda3p3-supply: true
  qcom,hsphy-init:
    $ref: /schemas/types.yaml#/definitions/uint32
    maximum: 67108863
    description: Parameter override value for analogue PHY tuning.

required:
  - compatible
  - reg
  - reg-names
  - "#phy-cells"
  - clocks
  - clock-names
  - resets
  - power-domains
  - power-domain-names
  - required-opps
  - vdda1p8-supply
  - vdda3p3-supply
  - qcom,hsphy-init

additionalProperties: false
```

## Documentation/devicetree/bindings/power/qcom,msm8992-saw-vctl.yaml
```yaml
# SPDX-License-Identifier: (GPL-2.0-only OR BSD-2-Clause)
%YAML 1.2
---
$id: http://devicetree.org/schemas/power/qcom,msm8992-saw-vctl.yaml#
$schema: http://devicetree.org/meta-schemas/core.yaml#

title: Qualcomm MSM8992 SAW voltage-control register bank

maintainers:
  - Konrad Dybcio <konradybcio@kernel.org>

description: |
  The system/CCI SAW controls the A53 APC supply; the A57 L2 SAW controls
  the A57 APC supply. The regulator uses the factory port-0 voltage path.
  This register-bank description does not enable CPU idle or suspend modes.

properties:
  compatible:
    items:
      - const: qcom,msm8992-saw-vctl
      - const: syscon

  reg:
    maxItems: 1

  qcom,saw2-spm-dly:
    description: Factory SPM delay configuration, applied on the first voltage request
    $ref: /schemas/types.yaml#/definitions/uint32
    enum: [0x3c100c00, 0x3c100c30]

required:
  - compatible
  - reg
  - qcom,saw2-spm-dly

additionalProperties: false
```

## Documentation/devicetree/bindings/power/supply/qcom,pmi8994-battery.yaml
```yaml
# SPDX-License-Identifier: (GPL-2.0-only OR BSD-2-Clause)
%YAML 1.2
---
$id: http://devicetree.org/schemas/power/supply/qcom,pmi8994-battery.yaml#
$schema: http://devicetree.org/meta-schemas/core.yaml#

title: Qualcomm PMI8994 firmware-calibrated battery monitor

maintainers:
  - Sebastian Reichel <sre@kernel.org>

description: |
  The PMI8994 gauge at 0x4000 uses the SRAM interface at 0x4400 and the
  charger at 0x1000, all on the same SPMI USID. The driver keeps the firmware
  profile and autonomous charger configuration. Software current requests
  are limited to the smaller of the board rating and inherited charger limit.

properties:
  compatible:
    const: qcom,pmi8994-battery
  reg:
    items:
      - const: 0x4000
  interrupts:
    maxItems: 6
  interrupt-names:
    items:
      - const: delta-soc
      - const: low-soc
      - const: batt-missing
      - const: usb-source
      - const: batt-hot
      - const: batt-cold
  qcom,fast-charge-current-max-microamp:
    $ref: /schemas/types.yaml#/definitions/uint32
    minimum: 300000
    maximum: 1800000
  qcom,battery-voltage-max-microvolt:
    $ref: /schemas/types.yaml#/definitions/uint32
    const: 4400000

required:
  - compatible
  - reg
  - qcom,fast-charge-current-max-microamp
  - qcom,battery-voltage-max-microvolt

additionalProperties: false
```

## Documentation/devicetree/bindings/regulator/qcom,qca6174-wlan-power.yaml
```yaml
# SPDX-License-Identifier: (GPL-2.0-only OR BSD-2-Clause)
%YAML 1.2
---
$id: http://devicetree.org/schemas/regulator/qcom,qca6174-wlan-power.yaml#
$schema: http://devicetree.org/meta-schemas/core.yaml#

title: Qualcomm QCA6174 PCIe WLAN board power switch

maintainers:
  - Libra maintainers <codex@openai.com>

description: |
  The WLAN power switch holds the PCIe boot straps high, enables PA, IO
  and crystal supplies in order, then asserts WLAN_EN. The PA supply can
  be shared with Bluetooth; each consumer holds its own regulator vote.

allOf:
  - $ref: regulator.yaml#

properties:
  compatible:
    const: qcom,qca6174-wlan-power
  vddpa-supply:
    description: External PA supply switch
  vddio-supply:
    description: 1.8 V IO supply
  vddxo-supply:
    description: 1.8 V crystal supply
  enable-gpios:
    maxItems: 1
  bootstrap-gpios:
    minItems: 3
    maxItems: 3
    description: WLAN PCIe boot straps, held high before WLAN_EN

required:
  - compatible
  - regulator-name
  - vddpa-supply
  - vddio-supply
  - vddxo-supply
  - enable-gpios
  - bootstrap-gpios

unevaluatedProperties: false
...
```
