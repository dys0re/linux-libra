// SPDX-License-Identifier: BSD-3-Clause
/* Start with the firmware framebuffer; load native DRM after USB is usable. */
#include "msm8992-xiaomi-libra.dts"

&framebuffer0 { status = "okay"; };

/* Keep probe-only tests dark until native scanout is explicitly verified. */
&pmi8994_wled { default-brightness = <0>; };

&mmcc {
	/* Resolve PLL outputs by clock name when the MSM module registers them.
	 * The PLL itself needs MMCC's AHB clock and MDSS power domain.
	 */
	clocks = <&xo_board>,
		 <&gcc GPLL0_OUT_MMSSCC>,
		 <&rpmcc RPM_SMD_MMSSNOC_AHB_CLK>,
		 <&rpmcc RPM_SMD_GFX3D_CLK_SRC>,
		 <0>, <0>, <0>, <0>, <0>;
};
